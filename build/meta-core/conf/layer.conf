## build/meta-core/conf/layer.conf
```bitbake
BBPATH .= ":${LAYERDIR}"
BBFILES += "${LAYERDIR}/recipes-*/*/*.bb ${LAYERDIR}/recipes-*/*/*.bbappend"
BBFILE_COLLECTIONS += "platformcore"
BBFILE_PATTERN_platformcore = "^${LAYERDIR}/"
BBFILE_PRIORITY_platformcore = "10"
LAYERSERIES_COMPAT_platformcore = "scarthgap"
LAYERDEPENDS_platformcore = "core"
CORE_REPO_ROOT := "${LAYERDIR}/../.."
```
